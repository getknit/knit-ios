## CMakeLists.txt
```
# Zephyr's hci_usb sample with Knit's controller settings: build it with scripts/dongle-firmware.sh.
cmake_minimum_required(VERSION 3.20.0)
find_package(Zephyr REQUIRED HINTS $ENV{ZEPHYR_BASE})
project(knit_hci)

include(${ZEPHYR_BASE}/samples/subsys/usb/common/common.cmake)
target_sources(app PRIVATE src/main.c)
```

## Kconfig
```
# The USB sample options hci_usb uses, from the Zephyr tree.
source "samples/subsys/usb/common/Kconfig.sample_usbd"

source "Kconfig.zephyr"
```

## prj.conf
```kconfig
# Zephyr's hci_usb sample: the controller only, behind USB's Bluetooth class, which btusb drives.
CONFIG_BT=y
CONFIG_BT_HCI_RAW=y
CONFIG_SERIAL=n
CONFIG_CONSOLE=n
CONFIG_UART_CONSOLE=n
CONFIG_USB_DEVICE_STACK_NEXT=y
# The dongle's board brings USB up at boot for a console; this app brings it up for HCI instead.
CONFIG_BOARD_SERIAL_BACKEND_CDC_ACM=n
CONFIG_USBD_BT_HCI=y
CONFIG_SAMPLE_USBD_PID=0x000B
CONFIG_SAMPLE_USBD_PRODUCT="Knit nRF52840 HCI"
# A serial number per chip, so lsusb tells the two dongles apart.
CONFIG_HWINFO=y

# What the Edimax and the ATS2851 lacked (.agents/context/linux-peer.md, "The adapter").
# 251-byte LE buffers and data length, so the kernel offers an LE CoC MPS of 247. The sample's 27 gives 23,
# which stalls an iPhone's writes.
CONFIG_BT_BUF_ACL_TX_SIZE=251
CONFIG_BT_BUF_ACL_TX_COUNT=8
CONFIG_BT_BUF_ACL_RX_SIZE=251
CONFIG_BT_CTLR_DATA_LENGTH_MAX=251
CONFIG_BT_CTLR_RX_BUFFERS=10
# Room for the six links a busy peer holds, and two more.
CONFIG_BT_MAX_CONN=8
# Advertising sets of its own, so the peer advertises while it holds links in either role.
CONFIG_BT_CTLR_ADV_EXT=y
CONFIG_BT_CTLR_ADV_SET=4
# Extended advertising's commands and reports outgrow the sample's 65- and 68-byte buffers.
CONFIG_BT_BUF_CMD_TX_SIZE=255
CONFIG_BT_BUF_EVT_RX_SIZE=255
CONFIG_BT_BUF_EVT_RX_COUNT=16
# The nRF52840's most, +8 dBm: the dongle's printed antenna is small, and the phones sit metres away.
CONFIG_BT_CTLR_TX_PWR_PLUS_8=y
```

## src/main.c
```c
/*
 * A Bluetooth LE controller over USB for knit-peer: Zephyr's hci_usb sample, plus a public address.
 *
 * Zephyr's controller reports 00:00:00:00:00:00 as its public address and runs on a static random one. knit-peer
 * binds every socket to its adapter's public address, and the scripts find adapters by the address sysfs shows, so
 * each dongle reports its factory device address as public instead (.agents/context/linux-peer.md, "The adapter").
 */

#include <zephyr/bluetooth/controller.h>
#include <zephyr/kernel.h>
#include <zephyr/sys/printk.h>
#include <zephyr/usb/usbd.h>

#include <hal/nrf_ficr.h>
#include <sample_usbd.h>

/* The 48-bit device address Nordic programs into each chip's FICR, least significant byte first, as HCI wants it.
 * An HCI Reset clears only the random address, so this one holds until the dongle loses power. */
static void set_public_address(void)
{
    uint32_t low = nrf_ficr_deviceaddr_get(NRF_FICR, 0);
    uint32_t high = nrf_ficr_deviceaddr_get(NRF_FICR, 1);
    uint8_t address[6] = {
        low & 0xff, (low >> 8) & 0xff, (low >> 16) & 0xff, (low >> 24) & 0xff, high & 0xff, (high >> 8) & 0xff,
    };

    bt_ctlr_set_public_addr(address);
}

int main(void)
{
    struct usbd_context *usbd;

    /* Before USB comes up, so the host's first Read BD_ADDR already sees it. */
    set_public_address();

    usbd = sample_usbd_init_device(NULL);
    if (usbd == NULL) {
        printk("Failed to initialize USB device\n");
        return -ENODEV;
    }
    if (usbd_enable(usbd) != 0) {
        printk("Failed to enable USB\n");
        return 0;
    }
    return 0;
}
```
